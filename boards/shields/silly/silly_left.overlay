#include "silly.dtsi"
#include <physical_layouts.dtsi>

/ {
    chosen {
        zmk,kscan = &kscan_matrix;
        zmk,physical-layout = &physical_layout;
    };
};

&default_transform {
    col-offset = <0>;
};
