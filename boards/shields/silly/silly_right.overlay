#include "silly.dtsi"
#include <physical_layouts.dtsi>

&default_transform {
    col-offset = <6>;
};

&kscan_matrix {
    col-gpios
        = <&pro_micro 14 GPIO_ACTIVE_HIGH>  /* C5 P1.11 */
        , <&pro_micro 15 GPIO_ACTIVE_HIGH>  /* C4 P1.13 */
        , <&pro_micro 18 GPIO_ACTIVE_HIGH>  /* C3 P1.15 */
        , <&pro_micro 19 GPIO_ACTIVE_HIGH>  /* C2 P0.02 */
        , <&pro_micro 20 GPIO_ACTIVE_HIGH>  /* C1 P0.29 */
        , <&pro_micro 21 GPIO_ACTIVE_HIGH>  /* C0 P0.31 */
        ;
};
