## boards/shields/silly/Kconfig.defconfig
```kconfig
if SHIELD_SILLY_DONGLE

config ZMK_KEYBOARD_NAME
    default "silly"

config ZMK_SPLIT_ROLE_CENTRAL
    default y

endif

if SHIELD_SILLY_LEFT || SHIELD_SILLY_RIGHT || SHIELD_SILLY_DONGLE

config ZMK_SPLIT
    default y

endif
```

## config/boards/shields/Kconfig.defconfig
```kconfig
if SHIELD_SILLY_LEFT

config ZMK_KEYBOARD_NAME
    default "silly"

config ZMK_SPLIT_ROLE_CENTRAL
    default y

endif

if SHIELD_SILLY_RIGHT

config ZMK_KEYBOARD_NAME
    default "silly"

endif

if SHIELD_SILLY_LEFT || SHIELD_SILLY_RIGHT

config ZMK_SPLIT
    default y

endif
```

## config/shields/silly/Kconfig.shield
```kconfig
config SHIELD_SILLY_LEFT
    def_bool $(shields_list_contains,silly_left)

config SHIELD_SILLY_RIGHT
    def_bool $(shields_list_contains,silly_right)
```
